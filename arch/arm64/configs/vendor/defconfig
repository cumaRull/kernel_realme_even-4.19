## arch/arm64/configs/vendor/defconfig
```kconfig
#ifdef OPLUS_FEATURE_UIFIRST
CONFIG_SCHED_WALT=y
#endif /* OPLUS_FEATURE_UIFIRST */
#ifdef OPLUS_FEATURE_ZRAM_OPT
CONFIG_OPLUS_ZRAM_OPT=y
CONFIG_CRYPTO_LZ4=y
CONFIG_PGTABLE_MAPPING=y
#endif /* OPLUS_FEATURE_ZRAM_OPT */
CONFIG_CRYPTO_ZSTD=y

CONFIG_OPLUS_ALLBOOST_OPT=y

#ifdef OPLUS_FEATURE_MM
CONFIG_BALANCE_ANON_FILE_RECLAIM=y
#endif

CONFIG_OPLUS_FEATURE_KTV_V2_NONDAPM=y
CONFIG_EXT4_FSYNC=y

CONFIG_EXT4_ASYNC_DISCARD_SUPPORT=y
#endif
#ifdef OPLUS_FEATURE_IOMONITOR
CONFIG_IOMONITOR=y
CONFIG_IOMONITOR_WITH_F2FS=n
#endif /*OPLUS_FEATURE_IOMONITOR*/

#ifdef OPLUS_FEATURE_WIFI_SLA
#todo: need to change to m when GKI
CONFIG_OPLUS_FEATURE_WIFI_SLA=y
#endif /* OPLUS_FEATURE_WIFI_SLA */

#ifdef OPLUS_FEATURE_DATA_EVAL
CONFIG_OPLUS_FEATURE_DATA_EVAL=y
#endif /*OPLUS_FEATURE_DATA_EVAL*/

#ifdef OPLUS_FEATURE_HEALTHINFO
CONFIG_OPLUS_JANK_INFO=y
#endif /* OPLUS_FEATURE_HEALTHINFO */
#ifdef OPLUS_FEATURE_HEALTHINFO
CONFIG_OPLUS_MEM_MONITOR=y
CONFIG_FG_TASK_UID=y
CONFIG_OPLUS_HEALTHINFO=y
CONFIG_SCHEDSTATS=y
#endif /*OPLUS_FEATURE_HEALTHINFO*/
CONFIG_OPLUS_FEATURE_SHUTDOWN_DETECT=y

#ifdef OPLUS_FEATURE_FEEDBACK
CONFIG_OPLUS_FEATURE_FEEDBACK=y
#endif /*OPLUS_FEATURE_FEEDBACK*/

#ifdef OPLUS_FEATURE_FG_IO_OPT
CONFIG_OPLUS_FG_IO_OPT=y
#endif

CONFIG_INPUT_JOYSTICK=y
CONFIG_JOYSTICK_XPAD=y
CONFIG_JOYSTICK_XPAD_FF=y
CONFIG_JOYSTICK_XPAD_LEDS=y

#ifdef OPLUS_FEATURE_MEMLEAK_DETECT
CONFIG_KMALLOC_DEBUG=y
CONFIG_VMALLOC_DEBUG=y
CONFIG_DUMP_TASKS_MEM=y
#endif

#ifdef OPLUS_FEATURE_ACM
CONFIG_OPLUS_FEATURE_ACM=y
CONFIG_OPLUS_FEATURE_ACM_LOGGING=y
#endif /* OPLUS_FEATURE_ACM */

CONFIG_OPLUS_FEATURE_PMIC_MONITOR_MTK=y

#ifdef OPLUS_MTK_USERIMAGES_USE_F2FS
CONFIG_F2FS_FS=y
CONFIG_F2FS_FS_SECURITY=y
#endif /* OPLUS_MTK_USERIMAGES_USE_F2FS */
CONFIG_LOG_BUF_SHIFT=20
CONFIG_OPLUS_FEATURE_EXT4_FSYNC=y

CONFIG_OPLUS_FEATURE_OF2FS=y
CONFIG_EROFS_FS=y
#ifdef OPLUS_FEATURE_SENSOR
CONFIG_OPLUS_ALS_CALI=y
#endif


CONFIG_SIA_PA_ALGO=y

#ifdef OPLUS_FEATURE_NFC_BRINGUP
CONFIG_OPLUS_NFC=y
CONFIG_NFC_PN553_DEVICES=y
#endif /*OPLUS_FEATURE_NFC_BRINGUP*/

#ifdef OPLUS_FEATURE_SECURITY_COMMON
CONFIG_MODULE_SIG=y
CONFIG_MODULE_SIG_FORCE=y
CONFIG_MODULE_SIG_ALL=y
CONFIG_MODULE_SIG_SHA512=y
#endif /* OPLUS_FEATURE_SECURITY_COMMON */

#ifdef OPLUS_FEATURE_HYBRIDSWAP
CONFIG_HYBRIDSWAP=y
CONFIG_HYBRIDSWAP_SWAPD=y
CONFIG_HYBRIDSWAP_CORE=y
#endif

#ifdef OPLUS_FEATURE_STATS_CALC
CONFIG_OPLUS_FEATURE_STATS_CALC=y
#endif /* OPLUS_FEATURE_STATS_CALC */

#ifdef OPLUS_FEATURE_MULTI_KSWAPD
#/*.Kernel.MM, 2022-04-07,add multi kswapd support*/
CONFIG_OPLUS_MULTI_KSWAPD=y
#endif /*OPLUS_FEATURE_MULTI_KSWAPD*/
CONFIG_SIM_DETECT=y
CONFIG_MTK_SECURITY_SW_SUPPORT=y
#ifdef OPLUS_FEATURE_KEY_SECURITY
CONFIG_MTK_DRM_KEY_MNG_SUPPORT=y
CONFIG_MTK_SEC_VIDEO_PATH_SUPPORT=y
#endif /* OPLUS_FEATURE_KEY_SECURITY */
CONFIG_KPD_PMIC_LPRST_TD=1
CONFIG_MTK_AEE_UT=y
CONFIG_OPLUS_CHARGER_MTK_CHGIC=y
```
